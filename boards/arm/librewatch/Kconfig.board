## boards/arm/librewatch/Kconfig.defconfig
```kconfig
if BOARD_LIBREWATCH

config BOARD
    default "librewatch"

config BT_CTLR
    default BT

endif # BOARD_LIBREWATCH
```

## boards/arm/nrf52840_smartwatch/Kconfig.board
```kconfig
config BOARD_NRF52840_SMARTWATCH
	bool "nRF52840 SmartWatch"
	depends on SOC_NRF52840_QIAA
```

## boards/arm/nrf52840_smartwatch/Kconfig.defconfig
```kconfig
if BOARD_NRF52840_SMARTWATCH

config BOARD
    default "nrf52840_smartwatch"

config BT_CTLR
    default BT

endif # BOARD_NRF52840_SMARTWATCH
```

## boards/arm/nrf52840_smartwatch/nrf52840_smartwatch_defconfig
```kconfig
CONFIG_SOC_SERIES_NRF52X=y
CONFIG_SOC_NRF52840_QIAA=y
CONFIG_BOARD_NRF52840_SMARTWATCH=y

# Enable MPU
CONFIG_ARM_MPU=y

# Enable hardware stack protection
CONFIG_HW_STACK_PROTECTION=y

# Enable GPIO
CONFIG_GPIO=y
CONFIG_GPIO_AS_PINRESET=n
CONFIG_NFCT_PINS_AS_GPIOS=y
CONFIG_PINCTRL=y
```

## drivers/Kconfig
```kconfig
comment "External Drivers"

rsource "display/Kconfig"

rsource "kscan/Kconfig"

rsource "sensor/Kconfig"
```

## drivers/display/Kconfig
```kconfig
menuconfig GC9A01A
    bool "GC9A01A Display Driver"
    depends on SPI
    help
        Enable GC9A01A display driver
```

## drivers/kscan/Kconfig
```kconfig
menuconfig IT7259
    bool "IT7259 Kscan Driver"
    depends on I2C
    help
        Enable IT7259 kscan driver

if IT7259

config IT7259_CB_COUNT
    int "Maximum callback count"
    default 1
    help
        Maximum number of callbacks that can be registered

endif # IT7259
```

## drivers/sensor/icm42605/Kconfig
```kconfig
menuconfig ICM42605_I2C
    bool "ICM42605 6-Axis MEMS Motion Tracking Sensor"
    depends on I2C
    help
      Enable ICM42605 6-Axis MEMS Motion Tracking Sensor

if ICM42605_I2C

endif # ICM42605_I2C
```

## src/events/Kconfig
```kconfig
menu "Events"

config LIBREWATCH_PASSKEY_EVENT_INIT_LOG
    bool "Log passkey events"
    default y

config LIBREWATCH_UI_EVENT_INIT_LOG
    bool "Log UI events"
    default y

config LIBREWATCH_SENSORS_EVENT_INIT_LOG
    bool "Log sensors events"
    default y

config LIBREWATCH_MEDIA_EVENT_INIT_LOG
    bool "Log media player events"
    default y

config LIBREWATCH_DISCOVERY_EVENT_INIT_LOG
    bool "Log discovery events"
    default y

config LIBREWATCH_NOTIFICATION_EVENT_INIT_LOG
    bool "Log notification events"
    default y

config LIBREWATCH_DFU_EVENT_INIT_LOG
    bool "Log notification events"
    default y

endmenu
```

## src/modules/Kconfig
```kconfig
rsource "Kconfig.cts"
rsource "Kconfig.ams"
rsource "Kconfig.ancs"
rsource "Kconfig.passkey"
rsource "Kconfig.sensors"
rsource "Kconfig.discovery"
rsource "Kconfig.dfu"
rsource "Kconfig.bt_conn_params"
```

## src/modules/Kconfig.ams
```kconfig
menu "AMS"

config LIBREWATCH_AMS
    bool "Enable Apple Media Service module"
    depends on CAF
    depends on CAF_BLE_STATE
    depends on BT_AMS_CLIENT

config LIBREWATCH_AMS_MAX_STR_LEN
    int "Maximum AMS artist and title string length"
    default 100

if LIBREWATCH_AMS

module = LIBREWATCH_AMS
module-str = ams
source "subsys/logging/Kconfig.template.log_config"

endif

endmenu
```

## src/modules/Kconfig.ancs
```kconfig
menu "ANCS"

config LIBREWATCH_ANCS
    bool "Enable Apple Notification Center Service module"
    depends on CAF
    depends on CAF_BLE_STATE
    depends on BT_ANCS_CLIENT

config LIBREWATCH_ANCS_MAX_TITLE_SIZE
    int "Maximum title size including NUL character"
    default 50
    range 32 512

config LIBREWATCH_ANCS_MAX_MESSAGE_SIZE
    int "Maximum message size including NUL character"
    default 100
    range 32 512

config LIBREWATCH_ANCS_MAX_NOTIFICATIONS
    int "Maximum number of active notifications"
    default 10
    range 1 20

if LIBREWATCH_ANCS

module = LIBREWATCH_ANCS
module-str = ancs
source "subsys/logging/Kconfig.template.log_config"

endif

endmenu
```

## src/modules/Kconfig.ble_passkey
```kconfig
menu "BLE Passkey"

config SMARTWATCH_BLE_PASSKEY
    bool "Enable BLE passkey module"
    depends on CAF
    depends on CAF_BLE_STATE
    depends on SMARTWATCH_PASSKEY_EVENT
    help
      This module propagates ble passkey display information.

if SMARTWATCH_BLE_PASSKEY

module = SMARTWATCH_BLE_PASSKEY
module-str = ble_passkey
source "subsys/logging/Kconfig.template.log_config"

endif

endmenu
```

## src/modules/Kconfig.bt_conn_params
```kconfig
menu "BLE Connection Parameters Module"

config LIBREWATCH_BT_CONN_PARAMS
    bool "Enable BLE Connection Paramters module"
    depends on CAF_BLE_STATE
    help
        This module updates the BLE connection parameters.

if LIBREWATCH_BT_CONN_PARAMS

config LIBREWATCH_BT_CONN_PARAMS_INT_MIN
    int "Minimum connection interval (N * 1.25 milliseconds)"
    range 12 3200
    default 24 # 30 ms

config LIBREWATCH_BT_CONN_PARAMS_INT_MAX
    int "Maximum connection interval (N * 1.25 milliseconds)"
    range 12 3200
    default 48 # 60 ms

config LIBREWATCH_BT_CONN_PARAMS_LATENCY
    int "Slave latency"
    range 0 30
    default 0

config LIBREWATCH_BT_CONN_PARAMS_TIMEOUT
    int "Supervision timeout (N * 10 milliseconds)"
    range 200 600
    default 400 # 4000 ms

module = LIBREWATCH_BT_CONN_PARAMS
module-str = bt_conn_params
source "subsys/logging/Kconfig.template.log_config"

endif

endmenu
```

## src/modules/Kconfig.dfu
```kconfig
menu "Device Firmware Update"

config LIBREWATCH_DFU
    bool "Enable Device Firmware Update module"
    depends on CAF_BLE_STATE
	depends on MCUMGR_CMD_IMG_MGMT
	depends on MCUMGR_SMP_BT
	depends on BOOTLOADER_MCUBOOT
    help
       This module registers mcumgr image manager and sends dfu_status events.

if LIBREWATCH_DFU

module = LIBREWATCH_DFU
module-str = dfu
source "subsys/logging/Kconfig.template.log_config"

endif

endmenu
```

## src/modules/Kconfig.discovery
```kconfig
menu "Discovery"

config LIBREWATCH_DISCOVERY
    bool "Enable BLE discovery module"
    depends on CAF
    depends on CAF_BLE_STATE
    depends on BT_GATT_DM
    help
       This module discovers all specified central's services and propagates them as events.
       This module is needed because only 1 discovery procedure can be running at the same time.

if LIBREWATCH_DISCOVERY

module = LIBREWATCH_DISCOVERY
module-str = discovery
source "subsys/logging/Kconfig.template.log_config"

endif

endmenu
```

## src/modules/Kconfig.passkey
```kconfig
menu "Passkey module"

config LIBREWATCH_PASSKEY
    bool "Enable passkey module"
    depends on CAF
    depends on CAF_BLE_STATE
    help
      This module propagates ble passkey display information.

if LIBREWATCH_PASSKEY

module = LIBREWATCH_PASSKEY
module-str = passkey
source "subsys/logging/Kconfig.template.log_config"

endif

endmenu
```

## src/modules/Kconfig.sensors
```kconfig
menu "Sensors module"

config LIBREWATCH_SENSORS
    bool "Enable sensors module"
    help
      This module reads and forwards IMU's step count as events, and uses Raise to Wake to send power manager events.
      TODO - write to step count ble characteristic and reset step counter when new day begins.

if LIBREWATCH_SENSORS

config LIBREWATCH_SENSORS_FETCH_INTERVAL_FAST
    int "How often sensor values are read when system is not suspended."
    default 1000
    range 1 60000

config LIBREWATCH_SENSORS_FETCH_INTERVAL_SLOW
    int "How often sensor values are read when system is suspended."
    default 10000
    range 1 60000

module = LIBREWATCH_SENSORS
module-str = sensors
source "subsys/logging/Kconfig.template.log_config"

endif

endmenu
```

## src/ui/Kconfig
```kconfig
menu "UI"

config LIBREWATCH_UI_UPDATE_INTERVAL_MS
    int
    default 1

module = LIBREWATCH_UI
module-str = ui
source "subsys/logging/Kconfig.template.log_config"

endmenu
```
